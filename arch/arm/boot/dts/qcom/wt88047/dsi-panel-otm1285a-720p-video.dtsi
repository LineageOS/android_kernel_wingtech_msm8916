/* Copyright (c) 2014, The Linux Foundation. All rights reserved.
 *
 * This program is free software; you can redistribute it and/or modify
 * it under the terms of the GNU General Public License version 2 and
 * only version 2 as published by the Free Software Foundation.
 *
 * This program is distributed in the hope that it will be useful,
 * but WITHOUT ANY WARRANTY; without even the implied warranty of
 * MERCHANTABILITY or FITNESS FOR A PARTICULAR PURPOSE.  See the
 * GNU General Public License for more details.
 */

&mdss_mdp {
	dsi_otm1285a_720p_video: qcom,mdss_dsi_otm1285a_720p_video {
		qcom,mdss-dsi-panel-name = "otm1285a_HD720p_video_EBBG";
		qcom,mdss-dsi-panel-controller = <&mdss_dsi0>;
		qcom,mdss-dsi-panel-type = "dsi_video_mode";
		qcom,mdss-dsi-panel-destination = "display_1";
		qcom,mdss-dsi-panel-framerate = <60>;
		qcom,mdss-dsi-virtual-channel-id = <0>;
		qcom,mdss-dsi-stream = <0>;
		qcom,mdss-dsi-panel-width = <720>;
		qcom,mdss-dsi-panel-height = <1280>;
		qcom,mdss-pan-physical-width-dimension = <58>;
		qcom,mdss-pan-physical-height-dimension = <103>;
		qcom,mdss-dsi-h-front-porch = <35>;
		qcom,mdss-dsi-h-back-porch = <35>;
		qcom,mdss-dsi-h-pulse-width = <2>;
		qcom,mdss-dsi-h-sync-skew = <0>;
		qcom,mdss-dsi-v-back-porch = <7>;
		qcom,mdss-dsi-v-front-porch = <7>;
		qcom,mdss-dsi-v-pulse-width = <2>;
		qcom,mdss-dsi-h-left-border = <0>;
		qcom,mdss-dsi-h-right-border = <0>;
		qcom,mdss-dsi-v-top-border = <0>;
		qcom,mdss-dsi-v-bottom-border = <0>;
		qcom,mdss-dsi-bpp = <24>;
		qcom,mdss-dsi-color-order = "rgb_swap_rgb";
		qcom,mdss-dsi-underflow-color = <0xff>;
		qcom,mdss-dsi-border-color = <0>;
		qcom,mdss-dsi-on-command = [29 01 00 00 00 00 04 ff 12 85 01 29 01 00 00 00 00 02 00 80 29 01 00 00 00 00 03 ff 12 85 29 01 00 00 00 00 02 00 a2 29 01 00 00 00 00 02 c1 00 29 01 00 00 00 00 02 00 91 29 01 00 00 00 00 03 b3 08 10 29 01 00 00 00 00 02 00 b3 29 01 00 00 00 00 02 c0 33 29 01 00 00 00 00 02 00 b4 29 01 00 00 00 00 02 c0 50 29 01 00 00 00 00 02 00 80 29 01 00 00 00 00 02 c1 19 29 01 00 00 00 00 02 00 81 29 01 00 00 00 00 02 c1 19 29 01 00 00 00 00 02 00 82 29 01 00 00 00 00 02 c1 19 29 01 00 00 00 00 02 00 83 29 01 00 00 00 00 02 c1 19 29 01 00 00 00 00 02 00 90 29 01 00 00 00 00 03 c1 66 00 29 01 00 00 00 00 02 00 80 29 01 00 00 00 00 0a c0 00 96 00 08 08 00 96 08 08 29 01 00 00 00 00 02 00 80 29 01 00 00 00 00 09 c2 82 00 0a 00 83 00 0a 00 29 01 00 00 00 00 02 00 90 29 01 00 00 00 00 10 c2 00 08 03 0a 00 01 08 03 0a 00 02 08 03 0a 00 29 01 00 00 00 00 02 00 a0 29 01 00 00 00 00 10 c2 03 08 03 0a 00 04 08 03 0a 00 05 08 03 0a 00 29 01 00 00 00 00 02 00 b0 29 01 00 00 00 00 0b c2 82 08 03 0a 00 81 08 03 0a 00 29 01 00 00 00 00 02 00 ea 29 01 00 00 00 00 04 c2 88 08 33 29 01 00 00 00 00 02 00 fa 29 01 00 00 0a 00 04 c2 00 0c 00 29 01 00 00 00 00 02 00 80 29 01 00 00 00 00 02 c4 88 29 01 00 00 00 00 02 00 83 29 01 00 00 00 00 02 c4 20 29 01 00 00 00 00 02 00 80 29 01 00 00 00 00 08 cb 00 00 00 00 00 00 00 29 01 00 00 00 00 02 00 90 29 01 00 00 00 00 10 cb 00 00 00 00 00 00 00 00 00 00 00 00 00 00 00 29 01 00 00 00 00 02 00 a0 29 01 00 00 00 00 0d cb 00 00 00 00 00 00 00 00 00 00 00 00 29 01 00 00 00 00 02 00 c0 29 01 00 00 0a 00 10 cb 01 01 01 01 01 01 01 01 01 01 00 00 00 00 00 29 01 00 00 00 00 02 00 d0 29 01 00 00 0a 00 0d cb 00 00 00 00 00 00 01 01 01 00 00 00 29 01 00 00 00 00 02 00 f0 29 01 00 00 0a 00 0d cb 00 00 f0 03 30 30 00 00 00 00 00 00 29 01 00 00 00 00 02 00 80 29 01 00 00 0a 00 0b cc 01 03 04 05 06 07 08 09 0a 02 29 01 00 00 00 00 02 00 b0 29 01 00 00 0a 00 0b cc 02 0a 09 08 07 06 05 04 03 01 29 01 00 00 00 00 02 00 d0 29 01 00 00 00 00 10 cd 01 09 07 05 03 2d 2d 2d 2d 2d 2d 2d 2d 2d 2d 29 01 00 00 00 00 02 00 b0 29 01 00 00 00 00 10 cd 2d 2d 2d 2d 2d 2d 16 17 18 2d 2d 2d 2d 2d 2d 29 01 00 00 00 00 02 00 c0 29 01 00 00 00 00 0b cd 2d 2d 2d 27 28 29 2a 2b 1d 2d 29 01 00 00 00 00 02 00 a0 29 01 00 00 00 00 10 cd 0a 08 06 04 02 2d 2d 2d 2d 2d 2d 2d 2d 2d 2d 29 01 00 00 00 00 02 00 e0 29 01 00 00 00 00 10 cd 2d 2d 2d 2d 2d 2d 16 17 18 2d 2d 2d 2d 2d 2d 29 01 00 00 00 00 02 00 f0 29 01 00 00 00 00 0b cd 2d 2d 2d 27 28 29 2a 2b 1d 2d 29 01 00 00 00 00 02 00 e0 29 01 00 00 00 00 05 cc 00 fc 1f 07 29 01 00 00 00 00 02 00 a0 29 01 00 00 00 00 0d c0 00 01 15 04 00 15 04 00 00 ff ff 00 29 01 00 00 00 00 02 00 80 29 01 00 00 00 00 10 cd 0b 0b 0b 0b 0b 0b 0b 0b 0b 14 13 12 0b 0b 0b 29 01 00 00 00 00 02 00 00 29 01 00 00 00 00 02 d9 82 29 01 00 00 00 00 02 00 00 29 01 00 00 00 00 03 d8 34 34 29 01 00 00 00 00 02 00 00 29 01 00 00 00 00 19 e1 0e 17 27 36 3f 49 55 67 70 81 8b 91 6b 67 61 4f 3e 1f 28 23 1c 17 16 0d 29 01 00 00 00 00 02 00 00 29 01 00 00 00 00 19 e2 02 07 15 22 2b 35 41 54 60 75 81 8d 69 5d 53 43 30 2d 1a 15 0e 09 06 0b 29 01 00 00 00 00 02 00 00 29 01 00 00 00 00 19 e3 0e 17 27 36 3f 49 55 67 70 81 8b 91 6b 67 61 4f 3e 1f 28 23 1c 17 16 0d 29 01 00 00 00 00 02 00 00 29 01 00 00 00 00 19 e4 02 07 15 22 2b 35 41 54 60 75 81 8d 69 5d 53 43 30 2d 1a 15 0e 09 06 0b 29 01 00 00 00 00 02 00 00 29 01 00 00 00 00 19 e5 0e 17 27 36 3f 49 55 67 70 81 8b 91 6b 67 61 4f 3e 1f 28 23 1c 17 16 0d 29 01 00 00 00 00 02 00 00 29 01 00 00 00 00 19 e6 02 07 15 22 2b 35 41 54 60 75 81 8d 69 5d 53 43 30 2d 1a 15 0e 09 06 0b 29 01 00 00 00 00 02 00 00 29 01 00 00 00 00 02 59 03 29 01 00 00 00 00 02 00 90 29 01 00 00 00 00 0d ca cc ff a6 ff 80 ff 05 03 05 03 05 03 29 01 00 00 00 00 02 00 00 29 01 00 00 00 00 02 c6 10 29 01 00 00 00 00 02 00 00 29 01 00 00 00 00 13 c7 90 89 89 88 88 99 88 88 88 88 88 88 87 88 87 87 88 77 29 01 00 00 00 00 02 51 ff 29 01 00 00 00 00 02 53 2c 29 01 00 00 00 00 02 55 01 29 01 00 00 00 00 02 00 00 29 01 00 00 00 00 02 c6 10 29 01 00 00 00 00 02 00 92 29 01 00 00 00 00 05 c5 c0 17 c0 1b 29 01 00 00 00 00 02 00 97 29 01 00 00 00 00 02 c5 16 29 01 00 00 00 00 02 00 99 29 01 00 00 00 00 02 c5 1a 29 01 00 00 00 00 02 00 a2 29 01 00 00 00 00 05 c5 c0 17 c0 1b 29 01 00 00 00 00 02 00 a7 29 01 00 00 00 00 02 c5 16 29 01 00 00 00 00 02 00 a9 29 01 00 00 00 00 02 c5 1a 29 01 00 00 00 00 02 00 00 29 01 00 00 78 00 01 11 29 01 00 00 00 00 02 00 00 29 01 00 00 00 00 01 29];
		qcom,mdss-dsi-off-command = [05 01 00 00 00 00 02 28 00 05 01 00 00 78 00 02 10 00];
		qcom,mdss-dsi-on-command-state = "dsi_lp_mode";
		qcom,mdss-dsi-off-command-state = "dsi_hs_mode";
		qcom,mdss-dsi-h-sync-pulse = <10>;
		qcom,mdss-dsi-traffic-mode = "non_burst_sync_event";
		qcom,mdss-dsi-bllp-eof-power-mode;
		qcom,mdss-dsi-bllp-power-mode;
		qcom,mdss-dsi-lane-0-state;
		qcom,mdss-dsi-lane-1-state;
		qcom,mdss-dsi-lane-2-state;
		qcom,mdss-dsi-panel-timings = [8b 1e 14 00 44 48 18 22 19 03 04 00];
		qcom,mdss-dsi-t-clk-post = <0x04>;
		qcom,mdss-dsi-t-clk-pre = <0x1c>;
		qcom,mdss-dsi-bl-min-level = <1>;
		qcom,mdss-dsi-bl-max-level = <255>;
		qcom,mdss-dsi-bl-pmic-pwm-frequency = <100>;
		qcom,mdss-dsi-bl-pmic-bank-select = <0>;
		qcom,mdss-dsi-dma-trigger = "trigger_sw";
		qcom,mdss-dsi-mdp-trigger = "none";
		qcom,mdss-dsi-bl-pmic-control-type = "bl_ctrl_pwm";
		qcom,mdss-dsi-reset-sequence = <1 5>, <0 5>, <1 10>;
	};
};
